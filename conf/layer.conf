## conf/layer.conf
```bitbake
BBPATH .= ":${LAYERDIR}"
 
# We have a recipes directory, add to BBFILES
BBFILES += "${LAYERDIR}/recipes*/*/*.bb ${LAYERDIR}/recipes*/*/*.bbappend"
 
BBFILE_COLLECTIONS += "kongja"
BBFILE_PATTERN_kongja := "^${LAYERDIR}/"
BBFILE_PRIORITY_kongja = "10"
 
LICENSE_PATH += "${LAYERDIR}/licenses"
 
BBFILES += "${@' '.join('${LAYERDIR}/%s/recipes*/*/*.bbappend' % layer \
               for layer in BBFILE_COLLECTIONS.split())}"
BBFILES += "${@' '.join('${LAYERDIR}/%s/recipes*/images/*.bb' % layer \
               for layer in BBFILE_COLLECTIONS.split())}"
```
